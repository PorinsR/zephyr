## west.yml
```yaml
manifest:
  defaults:
    remote: upstream

  remotes:
    - name: upstream
      url-base: https://github.com/zephyrproject-rtos

  group-filter: [-optional]

  #
  # Please add items below based on alphabetical order
  projects:
    # Minimal set for Atmel SAM4S: HAL and CMSIS + libc
    - name: cmsis
      revision: 4b96cbb174678dcd3ca86e11e1f24bc5f8726da0
      path: modules/hal/cmsis
      groups:
        - hal
    - name: cmsis_6
      repo-path: CMSIS_6
      revision: 30a859f44ef8ab4dc8f84b03ed586fd16ccf9d74
      path: modules/hal/cmsis_6
      groups:
        - hal
    - name: hal_atmel
      revision: 065e57c5013051c8b7f2256271349c6942bd9344
      path: modules/hal/atmel
      groups:
        - hal
    - name: lvgl
      revision: b03edc8e6282a963cd312cd0b409eb5ce263ea75
      path: modules/lib/gui/lvgl

    - name: picolibc
      path: modules/lib/picolibc
      revision: d492d5fa7c96918e37653f303028346bb0dd51a2

  self:
    path: zephyr
    west-commands: scripts/west-commands.yml
    import: submanifests
```
